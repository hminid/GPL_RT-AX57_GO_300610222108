## release/src-mtk-MT798X/linux/linux-5.4.x/asus/Kconfig
```kconfig
choice
	prompt "Choose Product"
	help
	   Choose specific product for different hardware layout

config PANTHERA
	bool "Panther porting on PantherA RFB"

config PANTHERB
	bool "Panther porting on PantherB RFB"

config CHEETAH
	bool "Cheetah porting on Cheetah RFB"

config TUFAX4200
	bool "Panther TUF-AX4200/TUF-AX4200Q"

config TUFAX6000
	bool "Panther TUF-AX6000"

config RTAX59U
	bool "Panther RT-AX59U"

config PRTAX57_GO
	bool "Cheetah PRT-AX57_GO"

config RTAX52
	bool "Cheetah RT-AX52"

config RTAX57M
	bool "Cheetah RT-AX57M"

endchoice
```

## release/src-mtk-MT798X/linux/linux-5.4.x/drivers/mtd/nand/spi/Kconfig
```kconfig
# SPDX-License-Identifier: GPL-2.0-only
menuconfig MTD_SPI_NAND
	tristate "SPI NAND device Support"
	select MTD_NAND_CORE
	depends on SPI_MASTER
	select SPI_MEM
	help
	  This is the framework for the SPI NAND device drivers.

config MTD_SPI_NAND_W25N01KV
	tristate "Winbond W25N01KV Support"
	select MTD_SPI_NAND
	default n
	help
	  Winbond W25N01KV share the same ID with W25N01GV. However, they have
	  different attributes.
```
